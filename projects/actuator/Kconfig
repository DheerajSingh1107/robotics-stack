## projects/actuator/Kconfig
```kconfig
config EXAMPLES_ACTUATOR
	tristate "Actuonix L12-P actuator loop"
	default n
	depends on PWM && ADC
	---help---
		Drives an Actuonix L12-P (via Ext-R board) in a continuous
		extend/retract loop while printing position and current feedback.

		Requires:
		  CONFIG_STM32_TIM3_PWM=y  → /dev/pwm1 (PA6, TIM3 CH1)
		  CONFIG_STM32_ADC1=y      → /dev/adc0  (PA0=F1, PC0=F2)

if EXAMPLES_ACTUATOR

config EXAMPLES_ACTUATOR_PROGNAME
	string "Program name"
	default "actuator"

config EXAMPLES_ACTUATOR_PRIORITY
	int "Task priority"
	default 100

config EXAMPLES_ACTUATOR_STACKSIZE
	int "Stack size"
	default DEFAULT_TASK_STACKSIZE

config EXAMPLES_ACTUATOR_PWM_DEVPATH
	string "PWM device path"
	default "/dev/pwm1"

config EXAMPLES_ACTUATOR_ADC_DEVPATH
	string "ADC device path"
	default "/dev/adc0"

config EXAMPLES_ACTUATOR_SWEEP_STEPS
	int "Steps per extend/retract sweep"
	default 50
	range 1 500

config EXAMPLES_ACTUATOR_STEP_MS
	int "Delay between steps (ms)"
	default 40
	range 10 5000

endif # EXAMPLES_ACTUATOR
```

## projects/encoder/Kconfig
```kconfig
#
# For a description of the syntax of this configuration file,
# see the file kconfig-language.txt in the NuttX tools repository.
#

config EXAMPLES_ENCODER
	tristate "Encoder standalone app"
	default n
	depends on SPI_EXCHANGE && SPI_DRIVER
	---help---
		Enable a standalone SPI magnetic encoder application for
		validating raw count, angle, and velocity readout.

if EXAMPLES_ENCODER

config EXAMPLES_ENCODER_PROGNAME
	string "Program name"
	default "encoder"

config EXAMPLES_ENCODER_PRIORITY
	int "Task priority"
	default 100

config EXAMPLES_ENCODER_STACKSIZE
	int "Stack size"
	default DEFAULT_TASK_STACKSIZE

config EXAMPLES_ENCODER_DEFAULT_FREQ
	int "Default encoder sample frequency (Hz)"
	default 20000
	range 100 200000

config EXAMPLES_ENCODER_DEVPATH
	string "Encoder SPI device path"
	default "/dev/spi3"

config EXAMPLES_ENCODER_WARMUP_SAMPLES
	int "Encoder warmup samples"
	default 20
	range 1 200

config EXAMPLES_ENCODER_PPAIRS
	int "Encoder pole pairs"
	default 7
	range 1 64

config EXAMPLES_ENCODER_READ_WORD
	hex "Encoder read command word"
	default 0x3fff

config EXAMPLES_ENCODER_CPR
	int "Encoder counts per revolution"
	default 16384
	range 1 65535

config EXAMPLES_ENCODER_SPI_MODE
	int "Encoder SPI mode"
	default 1
	range 0 3

config EXAMPLES_ENCODER_SPI_NBITS
	int "Encoder SPI word size"
	default 16
	range 4 32

config EXAMPLES_ENCODER_SPI_FREQ
	int "Encoder SPI frequency (Hz)"
	default 1000000
	range 1000 25000000

endif # EXAMPLES_ENCODER
```

## projects/helloWorld/Kconfig
```kconfig
config EXAMPLES_HELLOWORLD
    tristate "HelloWorld example"
    default n
    ---help---
        Enable the HelloWorld example application.

config EXAMPLES_HELLOWORLD_PROGNAME
    string "Program name"
    depends on EXAMPLES_HELLOWORLD
    default "helloworld"

config EXAMPLES_HELLOWORLD_PRIORITY
    int "Task priority"
    depends on EXAMPLES_HELLOWORLD
    default 100

config EXAMPLES_HELLOWORLD_STACKSIZE
    int "Stack size"
    depends on EXAMPLES_HELLOWORLD
    default DEFAULT_TASK_STACKSIZE
```

## projects/motorctl/Kconfig
```kconfig
config EXAMPLES_MOTORCTL
    tristate "Motor control example"
    default n
    ---help---
        Enable the motor control example application.

config EXAMPLES_MOTORCTL_PROGNAME
    string "Program name"
    depends on EXAMPLES_MOTORCTL
    default "motorctl"

config EXAMPLES_MOTORCTL_PRIORITY
    int "Task priority"
    depends on EXAMPLES_MOTORCTL
    default 100

config EXAMPLES_MOTORCTL_STACKSIZE
    int "Stack size"
    depends on EXAMPLES_MOTORCTL
    default DEFAULT_TASK_STACKSIZE
```
